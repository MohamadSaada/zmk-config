## config/west.yml
```yaml
manifest:
  remotes:
    - name: cdc-mkb
      url-base: https://github.com/zmkfirmware
  projects:
    - name: zmk
      remote: zmkfirmware
      revision: main
      import: app/west.yml
  self:
    path: config
```
